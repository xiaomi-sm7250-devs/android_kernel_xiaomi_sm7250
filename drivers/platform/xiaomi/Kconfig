## drivers/platform/xiaomi/Kconfig
```kconfig
# Xiaomi configuration options

config MACH_XIAOMI
	bool "Xiaomi device"
	depends on ARCH_QCOM
	help
	  Support for Xiaomi products

config MACH_XIAOMI_SM7250
	bool "Xiaomi SM7250"
	depends on ARCH_QCOM
	select MACH_XIAOMI
	help
	  Support for Xiaomi SM7250 devices

menu "Xiaomi board selection"

	config MACH_XIAOMI_MONET
		bool "Xiaomi monet board"
		select MACH_XIAOMI_SM7250
		help
		  Support for Mi 10 Lite 5G

	config MACH_XIAOMI_VANGOGH
		bool "Xiaomi vangogh board"
		select MACH_XIAOMI_SM7250
		help
		  Support for Mi 10 Lite Zoom 5G

	config MACH_XIAOMI_PICASSO
		bool "Xiaomi picasso board"
		select MACH_XIAOMI_SM7250
		help
		  Support for Redmi K30 5G

endmenu
```
